/ {
    behaviors {
    	TD_LBKT: tap_dance_left_bracket {
    	    compatible = "zmk,behavior-tap-dance";
    	    label = "tap_dance_left_bracket";
    	    #binding-cells = <0>;
    	    tapping-term-ms = <TAPPING_TERM>;
    	    bindings = <&kp LPAR>, <&kp LBKT>, <&kp LS(LBKT)>;
    	};	
    	TD_RBKT: tap_dance_right_bracket {
    	    compatible = "zmk,behavior-tap-dance";
    	    label = "tap_dance_right_bracket";
    	    #binding-cells = <0>;
    	    tapping-term-ms = <TAPPING_TERM>;
    	    bindings = <&kp RPAR>, <&kp RBKT>, <&kp LS(RBKT)>;
    	};
    };
};
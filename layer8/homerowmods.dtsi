/ {
    behaviors {
        hm: homerow_mod {
        compatible = "zmk,behavior-hold-tap";
        label = "HOMEROW_MOD";
        #binding-cells = <2>;
        tapping-term-ms = <TAPPING_TERM>;
        quick-tap-ms = <0>;
        flavor = "tap-preferred";
        global-quick-tap;
        bindings = <&kp>, <&kp>;
        };
};
